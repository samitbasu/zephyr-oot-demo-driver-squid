## squid_sensor_module/zephyr/Kconfig
```kconfig
# Copyright (c) 2019 Nordic Semiconductor
# SPDX-License-Identifier: Apache-2.0

config SENSOR_SQUID
	bool "Support for the magic sensor squid driver (i2c temp sensor TI TMP117)"
```
